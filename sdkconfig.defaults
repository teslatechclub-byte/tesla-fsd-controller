## sdkconfig.defaults
```kconfig
CONFIG_AUTOSTART_ARDUINO=y
CONFIG_FREERTOS_HZ=1000
CONFIG_ESPTOOLPY_FLASHSIZE_8MB=y
CONFIG_ESPTOOLPY_FLASHSIZE_DETECT=n
CONFIG_PARTITION_TABLE_CUSTOM=y
CONFIG_PARTITION_TABLE_CUSTOM_FILENAME="min_spiffs.csv"
CONFIG_LWIP_L2_TO_L3_COPY=y
CONFIG_LWIP_IP_FORWARD=y
CONFIG_LWIP_IPV4_NAPT=y
CONFIG_ESPTOOLPY_FLASHMODE_QIO=y

# ── Wi-Fi / TCP throughput tuning (v1.4.31+) ──────────────────────────────
# IDF default TCP window/send buffer of 5760 caps single-stream throughput
# at ~2.3 Mbps (window÷RTT). 11520 doubles that; cost ~6 KB RAM/connection,
# worst case ~96 KB at 16 concurrent TCP connections (well within budget).
CONFIG_LWIP_TCP_WND_DEFAULT=11520
CONFIG_LWIP_TCP_SND_BUF_DEFAULT=11520
CONFIG_TCP_WND_DEFAULT=11520
CONFIG_TCP_SND_BUF_DEFAULT=11520
# Deeper TCP receive mailbox — fewer drops under NAPT burst load.
CONFIG_LWIP_TCP_RECVMBOX_SIZE=12
# Move lwip hot paths into IRAM. +10-20% throughput, costs ~10 KB IRAM.
CONFIG_LWIP_IRAM_OPTIMIZATION=y
# Larger Block-Ack window lets AMPDU batch more frames per ACK cycle.
# Bridge env peaks around here; cost ~2 KB RAM per window.
CONFIG_ESP32_WIFI_TX_BA_WIN=16
CONFIG_ESP32_WIFI_RX_BA_WIN=16
```
